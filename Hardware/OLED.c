#include "OLED.h"
#include "Delay.h"

static uint8_t i2c_errorCount = 0;

static uint32_t pow10(uint8_t n) {
    uint32_t v = 1;
    while (n--) v *= 10;
    return v;
}

/* ---------- I2C 总线恢复 ---------- */
void I2C_BusRecovery(void) {
    I2C_Cmd(I2C1, DISABLE);
    /* 释放 I2C 复用，切回普通 GPIO */
    GPIO_InitTypeDef g;
    g.GPIO_Mode  = GPIO_Mode_Out_OD;
    g.GPIO_Speed = GPIO_Speed_50MHz;
    g.GPIO_Pin   = GPIO_Pin_6 | GPIO_Pin_7;
    GPIO_Init(GPIOB, &g);

    /* 模拟 SCL 翻转，迫使从机释放 SDA */
    GPIO_SetBits(GPIOB, GPIO_Pin_6);
    for (uint8_t i = 0; i < 9; i++) {
        GPIO_ResetBits(GPIOB, GPIO_Pin_6);
        Delay_us(5);
        GPIO_SetBits(GPIOB, GPIO_Pin_6);
        Delay_us(5);
    }
    /* 产生 STOP 条件: SDA 拉低 → SCL 拉高 → SDA 拉高 */
    GPIO_ResetBits(GPIOB, GPIO_Pin_7);
    Delay_us(5);
    GPIO_SetBits(GPIOB, GPIO_Pin_6);
    Delay_us(5);
    GPIO_SetBits(GPIOB, GPIO_Pin_7);
    Delay_us(5);

    /* 恢复 I2C 复用 */
    g.GPIO_Mode = GPIO_Mode_AF_OD;
    GPIO_Init(GPIOB, &g);

    /* 重新初始化 I2C */
    I2C_InitTypeDef i2c;
    i2c.I2C_Mode                = I2C_Mode_I2C;
    i2c.I2C_ClockSpeed          = 400000;
    i2c.I2C_DutyCycle           = I2C_DutyCycle_2;
    i2c.I2C_Ack                 = I2C_Ack_Enable;
    i2c.I2C_AcknowledgedAddress = I2C_AcknowledgedAddress_7bit;
    i2c.I2C_OwnAddress1         = 0x00;
    I2C_Init(I2C1, &i2c);
    I2C_Cmd(I2C1, ENABLE);

    i2c_errorCount = 0;
}

/* ---------- hardware I2C helpers ---------- */
static int I2C_WriteByte(uint8_t devAddr, uint8_t regAddr, uint8_t data) {
    uint32_t t;
    t = 5000; while (I2C_GetFlagStatus(I2C1, I2C_FLAG_BUSY)) {
        if (--t == 0) break;
    }
    if (t == 0) { i2c_errorCount++; I2C_BusRecovery(); return -1; }

    I2C_GenerateSTART(I2C1, ENABLE);
    t = 5000; while (!I2C_CheckEvent(I2C1, I2C_EVENT_MASTER_MODE_SELECT)) { if (--t == 0) goto err; }
    I2C_Send7bitAddress(I2C1, devAddr, I2C_Direction_Transmitter);
    t = 5000; while (!I2C_CheckEvent(I2C1, I2C_EVENT_MASTER_TRANSMITTER_MODE_SELECTED)) { if (--t == 0) goto err; }
    I2C_SendData(I2C1, regAddr);
    t = 5000; while (!I2C_CheckEvent(I2C1, I2C_EVENT_MASTER_BYTE_TRANSMITTED)) { if (--t == 0) goto err; }
    I2C_SendData(I2C1, data);
    t = 5000; while (!I2C_CheckEvent(I2C1, I2C_EVENT_MASTER_BYTE_TRANSMITTED)) { if (--t == 0) goto err; }
    I2C_GenerateSTOP(I2C1, ENABLE);
    i2c_errorCount = 0;
    return 0;
err:
    i2c_errorCount++;
    I2C_GenerateSTOP(I2C1, ENABLE);
    return -1;
}

static void OLED_WriteCmd(uint8_t cmd) { I2C_WriteByte(OLED_ADDR, 0x00, cmd); }
static void OLED_WriteData(uint8_t dat) { I2C_WriteByte(OLED_ADDR, 0x40, dat); }

/* ---------- 6x8 ASCII font (0x20~0x7F) ---------- */
static const uint8_t F6x8[][6] = {
    {0x00,0x00,0x00,0x00,0x00,0x00}, /* sp */
    {0x00,0x00,0x00,0x2f,0x00,0x00}, /* !  */
    {0x00,0x00,0x07,0x00,0x07,0x00}, /* "  */
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    {0x00,0x00,0x06,0x09,0x09,0x06}, /* { not used */
};

static void OLED_SetCursor(uint8_t x, uint8_t y) {
    OLED_WriteCmd(0xB0 | y);
    OLED_WriteCmd(0x10 | ((x & 0xF0) >> 4));
    OLED_WriteCmd(0x00 | (x & 0x0F));
}

/* ---------- public API ---------- */
void OLED_Init(void) {
    /* I2C1 init */
    RCC_APB1PeriphClockCmd(RCC_APB1Periph_I2C1, ENABLE);
    RCC_APB2PeriphClockCmd(RCC_APB2Periph_GPIOB, ENABLE);
    GPIO_InitTypeDef g = {GPIO_Pin_6 | GPIO_Pin_7, GPIO_Speed_50MHz, GPIO_Mode_AF_OD};
    GPIO_Init(GPIOB, &g);

    I2C_InitTypeDef i2c;
    i2c.I2C_Mode = I2C_Mode_I2C;
    i2c.I2C_ClockSpeed = 400000;
    i2c.I2C_DutyCycle = I2C_DutyCycle_2;
    i2c.I2C_Ack = I2C_Ack_Enable;
    i2c.I2C_AcknowledgedAddress = I2C_AcknowledgedAddress_7bit;
    i2c.I2C_OwnAddress1 = 0x00;
    I2C_Init(I2C1, &i2c);
    I2C_Cmd(I2C1, ENABLE);

    /* SSD1306 init sequence */
    Delay_ms(100);
    OLED_WriteCmd(0xAE); // display off
    OLED_WriteCmd(0xD5); OLED_WriteCmd(0x80); // clock div
    OLED_WriteCmd(0xA8); OLED_WriteCmd(0x3F); // mux ratio
    OLED_WriteCmd(0xD3); OLED_WriteCmd(0x00); // display offset
    OLED_WriteCmd(0x40); // start line
    OLED_WriteCmd(0x8D); OLED_WriteCmd(0x14); // charge pump
    OLED_WriteCmd(0xA1); // seg remap
    OLED_WriteCmd(0xC8); // com scan dir
    OLED_WriteCmd(0xDA); OLED_WriteCmd(0x12); // com pins
    OLED_WriteCmd(0x81); OLED_WriteCmd(0xCF); // contrast
    OLED_WriteCmd(0xD9); OLED_WriteCmd(0xF1); // pre-charge
    OLED_WriteCmd(0xDB); OLED_WriteCmd(0x40); // vcom detect
    OLED_WriteCmd(0xA4); // display on resume
    OLED_WriteCmd(0xA6); // normal display
    OLED_WriteCmd(0xAF); // display on
}

void OLED_Clear(void) {
    uint8_t i, j;
    for (i = 0; i < 8; i++) {
        OLED_SetCursor(0, i);
        for (j = 0; j < 128; j++) OLED_WriteData(0x00);
    }
}

void OLED_ShowChar(uint8_t x, uint8_t y, uint8_t chr) {
    uint8_t i;
    OLED_SetCursor(x, y);
    for (i = 0; i < 6; i++) OLED_WriteData(F6x8[chr - 0x20][i]);
}

void OLED_ShowString(uint8_t x, uint8_t y, const char *str) {
    uint8_t i = 0;
    while (str[i]) {
        OLED_ShowChar(x + i * 6, y, str[i]);
        i++;
        if (x + i * 6 > 122) break;
    }
}

void OLED_ShowNum(uint8_t x, uint8_t y, uint32_t num, uint8_t len) {
    int8_t i;
    for (i = len - 1; i >= 0; i--) {
        OLED_ShowChar(x + i * 6, y, '0' + (num % 10));
        num /= 10;
    }
}

void OLED_ShowSignedNum(uint8_t x, uint8_t y, int32_t num, uint8_t len) {
    if (num < 0) { OLED_ShowChar(x, y, '-'); num = -num; }
    else OLED_ShowChar(x, y, ' ');
    OLED_ShowNum(x + 6, y, (uint32_t)num, len - 1);
}

void OLED_ShowFloat(uint8_t x, uint8_t y, float num, uint8_t intLen, uint8_t decLen) {
    if (num < 0) { OLED_ShowChar(x, y, '-'); num = -num; }
    else OLED_ShowChar(x, y, ' ');
    uint32_t intPart = (uint32_t)num;
    OLED_ShowNum(x + 6, y, intPart, intLen);
    OLED_ShowChar(x + 6 * (intLen + 1), y, '.');
    uint32_t decPart = (uint32_t)((num - intPart) * pow10(decLen) + 0.5);
    OLED_ShowNum(x + 6 * (intLen + 1) + 6, y, decPart, decLen);
}
